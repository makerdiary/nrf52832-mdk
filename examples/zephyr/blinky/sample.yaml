## examples/zephyr/blinky/sample.yaml
```yaml
sample:
  name: Blinky Sample
tests:
  test:
    platform_whitelist: nrf52832_mdk
    tags: samples
    depends_on: gpio
```

## examples/zephyr/bluetooth/beacon/sample.yaml
```yaml
sample:
  description: TBD
  name: TBD
tests:
  test:
    harness: bluetooth
    platform_whitelist: qemu_cortex_m3 qemu_x86 nrf52832_mdk
    tags: bluetooth
```
